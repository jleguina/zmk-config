## config/west.yml
```yaml
manifest:
  remotes:
    - name: zmkfirmware
      url-base: https://github.com/zmkfirmware
    - name: jleguina
      url-base: https://github.com/jleguina
  projects:
    - name: zmk
      remote: jleguina
      revision: jleguina
      import: app/west.yml
  self:
    path: config
```
